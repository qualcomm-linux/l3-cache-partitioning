## conf/layer.conf
```bitbake
# SPDX-License-Identifier: GPL-2.0-only
# Copyright (c) 2024-2025, Qualcomm Innovation Center, Inc. All rights reserved.

BBPATH .= ":${LAYERDIR}"

BBFILES += "${LAYERDIR}/recipes-*/*/*.bb \
            ${LAYERDIR}/recipes-*/*/*.bbappend"

BBFILE_COLLECTIONS += "qcom-cache-partition"
BBFILE_PATTERN_qcom-cache-partition := "^${LAYERDIR}/"
BBFILE_PRIORITY_qcom-cache-partition = "7"

LAYERDEPENDS_qcom-cache-partition = "core qcom"
LAYERSERIES_COMPAT_qcom-cache-partition = "wrynose"
```
